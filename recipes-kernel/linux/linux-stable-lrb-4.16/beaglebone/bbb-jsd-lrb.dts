/dts-v1/;
/plugin/;

#include "am33xx.dtsi"
#include "am335x-bone-common.dtsi"
#include "am335x-boneblack-common.dtsi"
#include "hcsr04.dtsi"

// JSD: potentially copy pru dtsi source from meta-ti
//#include "am335x-boneblack-prucape.dtsi"

/ {
	model = "TI AM335x BeagleBone Black";
	compatible = "ti,am335x-bone-black", "ti,am33xx";
};

&ldo3_reg {
	regulator-min-microvolt = <1800000>;
	regulator-max-microvolt = <1800000>;
	regulator-always-on;
};

&rtc {
	system-power-controller;
};
