## conf/layer.conf
```bitbake
# We have a conf and classes directory, append to BBPATH
BBPATH .= ":${LAYERDIR}"

# We have a recipes directory, add to BBFILES
BBFILES += " \
    ${LAYERDIR}/recipes*/*/*.bb \
    ${LAYERDIR}/recipes*/*/*.bbappend \
"

BBFILE_COLLECTIONS += "meta-jsd"
BBFILE_PATTERN_meta-jsd := "^${LAYERDIR}/"
BBFILE_PRIORITY_meta-jsd = "18"
LAYERSERIES_COMPAT_meta-jsd = "dunfell"

# Check whether this is the correct location, sync with machine conf!
PREFERRED_PROVIDER_virtual/kernel = "linux-ti-staging"
#PREFERRED_PROVIDER_virtual/kernel = "linux-ti-mainline"
#PREFERRED_VERSION_virtual/kernel = "5.10"
PREFERRED_PROVIDER_uboot = "u-boot-ti-staging"
#PREFERRED_VERSION_uboot = "2021.01"
#PREFERRED_VERSION_dtc = "1.6.0"
```

## conf/machine/beaglebone.conf
```bitbake
#@TYPE: Machine
#@NAME: Beaglebone 
#@DESCRIPTION: Machine configuration for the Beaglebone 

SOC_FAMILY = "ti335x"
TARGET_ARCH = "arm"

DEFAULTTUNE ?= "cortexa8hf-neon"

require conf/machine/include/soc-family.inc
require conf/machine/include/tune-cortexa8.inc

MACHINE_EXTRA_RRECOMMENDS = " kernel-modules kernel-devicetree"

#PREFERRED_PROVIDER_virtual/kernel = "linux-stable-lrb"
PREFERRED_PROVIDER_virtual/kernel = "linux-ti-staging"
PREFERRED_PROVIDER_virtual/bootloader = "u-boot"
PREFERRED_PROVIDER_u-boot = "u-boot"
KERNEL_IMAGETYPE = "zImage"

UBOOT_ENTRYPOINT = "0x80008000"
UBOOT_LOADADDRESS = "0x80008000"
UBOOT_MACHINE = "am335x_boneblack_config"
BOOTENV_SIZE = "0x20000"

EXTRA_IMAGEDEPENDS += "u-boot"

SERIAL_CONSOLE = "115200 ttyO0"

IMAGE_FSTYPES = "tar.xz ext4"
IMAGE_BOOT_FILES ?= "u-boot.${UBOOT_SUFFIX} MLO"
#IMAGE_INSTALL_append = " kernel-devicetree kernel-image-zimage"
EXTRA_IMAGEDEPENDS += "u-boot"

MACHINE_FEATURES = "serial usbhost vfat"
```
